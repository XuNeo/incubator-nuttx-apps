## examples/luavgldemo/Kconfig
```kconfig
#
# For a description of the syntax of this configuration file,
# see the file kconfig-language.txt in the NuttX tools repository.
#

menuconfig EXAMPLES_LUAVGLDEMO
	tristate "luavgl demo"
	default n
	depends on LUA_LUAVGL_MODULE
	---help---
		Enable build lvgl lua binding luavgl demo

if EXAMPLES_LUAVGLDEMO

config EXAMPLES_LUAVGLDEMO_PRIORITY
	int "luavgldemo task priority"
	default 100

config EXAMPLES_LUAVGLDEMO_STACKSIZE
	int "luavgldemo stack size"
	default 16384

endif # EXAMPLES_LUAVGLDEMO
```

## graphics/lvgl/Kconfig
```kconfig
#
# For a description of the syntax of this configuration file,
# see the file kconfig-language.txt in the NuttX tools repository.
#

menuconfig GRAPHICS_LVGL
	bool "Light and Versatile Graphic Library (LVGL)"
	default n
	---help---
		Enable support for the LVGL GUI library.

if GRAPHICS_LVGL

config LVGL_VERSION
	string "LVGL Version"
	default "9.0.1"

source "$APPSDIR/graphics/lvgl/lvgl/Kconfig"

endif # GRAPHICS_LVGL
```

## interpreters/luamodules/luavgl/Kconfig
```kconfig
#
# For a description of the syntax of this configuration file,
# see the file kconfig-language.txt in the NuttX tools repository.
#

config LUA_LUAVGL_MODULE
	bool "Lua LVGL binding module luavgl"
	default n
	depends on INTERPRETERS_LUA && GRAPHICS_LVGL
	---help---
		Bare lvgl bindings for Lua

if LUA_LUAVGL_MODULE

config LUA_LUAVGL_VERSION
	string "Luavgl version"
	default "0.0.1"
	---help---
		Luavgl release version to fetch and build.

endif # LUA_LUAVGL_MODULE
```
